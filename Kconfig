## Kconfig
```kconfig
menuconfig RPI_ACPI
    bool "Raspberry Pi ACPI support"
    depends on ACPI
    help
      Enables Raspberry Pi-specific ACPI drivers for mailbox, PWM, and PoE fan.

if RPI_ACPI

config RPI_PWM_FAN_ACPI
    tristate "Raspberry Pi PWM Fan ACPI driver"
    depends on ACPI
    help
      Enables support for the Raspberry Pi PoE HAT fan via ACPI thermal control.

config RPI_MAILBOX_ACPI
    tristate "Raspberry Pi ACPI mailbox client"
    depends on ACPI
    depends on MAILBOX
    help
      Enables the mailbox interface as an ACPI client device.

config RPI_PWM_POE_ACPI
    tristate "Raspberry Pi PoE PWM ACPI device"
    depends on ACPI
    depends on RPI_MAILBOX_ACPI
    help
      Enables support for controlling the PoE fan via PWM from ACPI.

config RPI_ACPI_THERMAL
    tristate "Raspberry Pi Thermal Device for PWM fan"
    depends on ACPI
    depends on THERMAL
    help
      Enables support for the Raspberry Pi Thermal Device Controller


endif
```

## drivers/acpi/rpi/Kconfig
```kconfig
menuconfig RPI_ACPI
    bool "Raspberry Pi ACPI support"
    depends on ACPI
    help
      Enables Raspberry Pi-specific ACPI drivers for mailbox, PWM, and PoE fan.

if RPI_ACPI

config RPI_PWM_FAN_ACPI
    tristate "Raspberry Pi PWM Fan ACPI driver"
    depends on ACPI
    help
      Enables support for the Raspberry Pi PoE HAT fan via ACPI thermal control.

config RPI_MAILBOX_ACPI
    tristate "Raspberry Pi ACPI mailbox client"
    depends on ACPI
    help
      Enables the mailbox interface as an ACPI client device.

config RPI_PWM_POE_ACPI
    tristate "Raspberry Pi PoE PWM ACPI device"
    depends on ACPI
    help
      Enables support for controlling the PoE fan via PWM from ACPI.

config RPI_THERMAL_ACPI
    tristate "Raspberry Pi ACPI Thermal Zone"
    depends on ACPI && THERMAL
    help
      Enables the ACPI thermal zone driver for Raspberry Pi. Provides thermal
      management and cooling support for Raspberry Pi devices using ACPI.

endif
```
